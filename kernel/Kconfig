## kernel/Kconfig
```kconfig
mainmenu "AurixOS $(KVERSION) ($(ARCH)) Kernel Configuration"

menu "$(ARCH)-specific"
source "arch/$(ARCH)/Kconfig"
endmenu

source "libs/Kconfig"
source "kernel/Kconfig"

config ARCH
    string
    default "$(ARCH)"

config CXX
    string
    default "$(CXX)"

config LD
    string
    default "$(LD)"

config NM
    string
    default "$(NM)"

config OBJCOPY
    string
    default "$(OBJCOPY)"

config CFLAGS
    string
    default "$(CFLAGS)"

config CXXFLAGS
    string
    default "$(CXXFLAGS)"

config LDFLAGS
    string
    default "$(LDFLAGS)"    

config KVERSION
    string
    default "$(KVERSION)"

menu "Build Options"

config C_OPTIM_LEVEL
	prompt "GCC Optimization Level"
	int
	default 3
	range 0 3
endmenu
```

## kernel/arch/aarch64/Kconfig
```kconfig
config ARCH_AARCH64
  bool
  default y

config UART_BAUD_RATE
  prompt "UART Baud Rate"
  int
  default 115200

config KPRINTF_BUFSIZE
	prompt "Logging default buffer size"
	int
	default 16000
	range 100 1000000
```

## kernel/arch/x86/Kconfig
```kconfig
config ARCH_X86
  bool
  default y

config ENABLE_KERNEL_64
  default y
  bool "64-bit kernel"

config ENABLE_KERNEL_32
  bool
  depends on !ENABLE_KERNEL_64
  default n

config ARCH_HAS_PAGING
  bool
  depends on !ENABLE_KERNEL_64
  default y
```

## kernel/kernel/Kconfig
```kconfig
menu "Kernel"
source "mm/Kconfig"

config KPRINTF_BUFSIZE
	prompt "Logging default buffer size"
	int
	default 16000
	range 100 1000000

config KPRINTF_LOGLEVEL
	prompt "Logging Level"
	int
	default 4
	range 0 5
	help
		0 = Fatal
		1 = Critical
		2 = Error
		3 = Warning
		4 = Info
		5 = Debug

endmenu
```
